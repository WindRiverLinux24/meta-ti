## meta-ti-bsp/conf/layer.conf
```bitbake
# We have a conf and classes directory, append to BBPATH
BBPATH .= ":${LAYERDIR}"
METATIBASE := '${@os.path.normpath("${LAYERDIR}/")}'

# We have a recipes directory, add to BBFILES
BBFILES += "${LAYERDIR}/recipes*/*/*.bb ${LAYERDIR}/recipes*/*/*.bbappend"

BBFILE_COLLECTIONS += "meta-ti-bsp"
BBFILE_PATTERN_meta-ti-bsp := "^${LAYERDIR}/"
BBFILE_PRIORITY_meta-ti-bsp = "6"

LAYERSERIES_COMPAT_meta-ti-bsp = "scarthgap"

LICENSE_PATH += "${LAYERDIR}/licenses"

LAYERDEPENDS_meta-ti-bsp = " \
    core \
    meta-arm \
"

BBMASK += "${LAYERDIR}/recipes-core/udev/"
BBMASK += "${LAYERDIR}/recipes-kernel/linux/"
BBMASK += "${LAYERDIR}/recipes-devtools/k3conf/"

RECIPE_LIST_REASON:meta-ti-bsp = "You are about to enable third-party components, there is additional third-part \
licensing involved, please consult your legal department should you have questions regarding the licensing terms and obligations."


BBFILES_DYNAMIC += " \
    clang-layer:${LAYERDIR}/dynamic-layers/clang-layer/recipes*/*/*.bbappend \
"

SIGGEN_EXCLUDERECIPES_ABISAFE += " \
    mesa-pvr \
"

HOSTTOOLS_NONFATAL += "truncate xxd comm"

TI_COMMON_DEPLOY ?= "${TOPDIR}/deploy-ti"
DEPLOY_DIR_IMAGE:ti-soc = "${TI_COMMON_DEPLOY}/images/${MACHINE}"
SDK_DEPLOY:ti-soc = "${TI_COMMON_DEPLOY}/sdk"
PSEUDO_IGNORE_PATHS:append:ti-soc = ",${TI_COMMON_DEPLOY}"
```
